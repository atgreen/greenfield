## Kconfig
```kconfig
##
## This file is part of the greenfield project.
##
## Copyright (C) 2015 Anthony Green <green@redhat.com>
##
## This program is free software; you can redistribute it and/or modify
## it under the terms of the GNU General Public License as published by
## the Free Software Foundation; version 2 of the License.
##
## This program is distributed in the hope that it will be useful,
## but WITHOUT ANY WARRANTY; without even the implied warranty of
## MERCHANTABILITY or FITNESS FOR A PARTICULAR PURPOSE.  See the
## GNU General Public License for more details.
##
## You should have received a copy of the GNU General Public License
## along with this program; if not, write to the Free Software
## Foundation, Inc.
##

mainmenu "greenfield configuration"

config LIBRARY_DIRECTORY
	string "Library Directory Path"
	default "/mnt/red/Library"
	help
	  Directory holding relevant distribution media (ISOs, zip files, etc).

config LIBRARY_URL
	string "Library URL"
	default "http://10.0.0.1/Library"
	help
	  URL accessable by guests to access the Library.

config MOUNTPOINT
        string "Mount Point"
	default "/mnt"
	help
	  A mount point directory on this host on which to 
          mount a RHEL DVD ISO.

config LIBVIRT_IMAGEDIR
       string "Libvirt Image Directory"
       default "/var/lib/libvirt/images"
       help
          Directory holding libvirt managed guest images.

config DOMAIN
	string "Domain"
	default "example.com"
	help
	  Enter the full domain of our new greenfield environment.
	  E.g. example.com

config RHN_USERNAME
	string "RHN User Name"
	help
	  Username to connect to Red Hat Network.

config RHN_PASSWORD
	string "RHN Password"
	help
	  Password to connect to Red Hat Network.

config SUBSCRIPTION_POOL_RHEL
	string "RHN Subscription Pool for RHEL"
	help
	  The subscription pool ID to subscribe all generic RHEL systems to.

config SUBSCRIPTION_POOL_SATELLITE
	string "RHN Subscription Pool for Satellite"
	help
	  The subscription pool ID to subscribe all Satellite systems to.

config SUBSCRIPTION_POOL_OPENSHIFT
	string "RHN Subscription Pool for OpenShift Enterprise"
	help
	  The subscription pool ID to subscribe all OpenShift systems to.

config MANIFEST
	string "Satellite manifest file name"
	help
	  The file name for the satellite manifest file (relative to Library).

config DNS_FORWARDER
        string "DNS Forwarder IP"
	help
	  The IP address of a DNS forwarder.

config TIMEZONE
        string "Timezone"
	default "America/Toronto"
	help
	  The system's timezone string.

config ROOT_PASSWORD
	string "Root Password"
	help
	  Password for the root account on all systems.

config ADMIN_PASSWORD
	string "Application Admin Password"
	help
	  Password for the admin account in all applications.

config YUM_UPDATE
	bool "Perform a post install yum update"
	default n
	help
	  Enable this option if you want to run 'yum update'
	  once a server has installed from the cloud image or ISO.

	  Otherwise, say N to use the provided packages.
```
